## CMakeLists.txt
```
# -----------------------------------------------------------------------------
# Copyright (c) 2024 WeeGee bv

cmake_minimum_required(VERSION 3.13.1)
find_package(Zephyr REQUIRED HINTS $ENV{ZEPHYR_BASE})

project(app LANGUAGES C)

target_sources(app PRIVATE src/main.c)
target_sources(app PRIVATE src/ble.c)
target_sources(app PRIVATE src/tgm_service.c)
target_sources(app PRIVATE src/ppg.c)
target_sources(app PRIVATE src/acc.c)
```

## Kconfig
```
# Copyright (c) 2021 Nordic Semiconductor ASA
# SPDX-License-Identifier: Apache-2.0
#
# This file is the application Kconfig entry point. All application Kconfig
# options can be defined here or included via other application Kconfig files.
# You can browse these options using the west targets menuconfig (terminal) or
# guiconfig (GUI).

menu "Zephyr"
source "Kconfig.zephyr"
endmenu

config PPG_SAMPLES_PER_FRAME
    int "Number of PPG samples per frame"
    default 25
    help
      Number of PPG samples per frame. 

config ACC_SAMPLES_PER_FRAME
    int "Number of ACC samples per frame"
    default 25
    help
      Number of accelerometer samples per frame. 

  config BATTERY_MEASUREMENT_INTERVAL
    int "Battery measurement interval"
    default 300
    help
      Battery sampling interval in seconds.

module = APP
module-str = APP
source "subsys/logging/Kconfig.template.log_config"
```

## prj.conf
```kconfig
# Copyright (c) 2024 WeeGee bv
#
# This file contains selected Kconfig options for the TGM application.

# Enable BLE
CONFIG_BT=y
CONFIG_BT_PERIPHERAL=y
CONFIG_BT_DEVICE_NAME="TGM"

# For requesting ATT_MTU update
CONFIG_BT_GATT_CLIENT=y
# For data length update
CONFIG_BT_USER_DATA_LEN_UPDATE=y 
# Max supported by Nordic Softdevice controller
CONFIG_BT_CTLR_DATA_LENGTH_MAX=251 
CONFIG_BT_BUF_ACL_TX_SIZE=251
CONFIG_BT_BUF_ACL_RX_SIZE=251
# Maximum supported by Nordic Softdevice controller (Data length - 4)
CONFIG_BT_L2CAP_TX_MTU=247

# Enable Floating Point Unit
CONFIG_FPU=y 

# Enable the sensor drivers
CONFIG_GPIO=y
CONFIG_I2C=y
CONFIG_SENSOR=y
CONFIG_ADC=y

# PPG
CONFIG_MAXM86161=y
CONFIG_PPG_SAMPLES_PER_FRAME=20

# Accelerometer
CONFIG_LIS2DTW12=y
CONFIG_ACC_SAMPLES_PER_FRAME=25

# Battery
CONFIG_BATTERY_MEASUREMENT_INTERVAL=300

# Temperature
CONFIG_SENSOR=y
CONFIG_TEMPERATURE_MEASUREMENT_INTERVAL=1

# Debugging
CONFIG_LOG=y 
CONFIG_LOG_PROCESS_THREAD_STACK_SIZE=1024
CONFIG_DEBUG_OPTIMIZATIONS=y
CONFIG_DEBUG_THREAD_INFO=y

# DFU functionality
# CONFIG_CRC=y
# CONFIG_FLASH=y
# CONFIG_FLASH_MAP=y
# CONFIG_MCUMGR=y
# CONFIG_MCUMGR_TRANSPORT_BT=y
# CONFIG_NET_BUF=y
CONFIG_NCS_SAMPLE_MCUMGR_BT_OTA_DFU=y
```

## src/main.c
```c
/*
 * Copyright (c) 2024 WeeGee bv
 */

#include <zephyr/kernel.h>
#include <zephyr/device.h>
#include <zephyr/drivers/gpio.h>
#include <zephyr/drivers/sensor.h>

#include <app_version.h>

#include "ble.h"
#include "ppg.h"
#include "acc.h"
#include "battery.h"
#include "tgm_service.h"

#include <zephyr/logging/log.h>
LOG_MODULE_REGISTER(main, CONFIG_APP_LOG_LEVEL);

#define GPIO_NODE DT_NODELABEL(gpio0)
#define SENS_ENABLE_PIN 8

// Device temperature thresholds, with hysteresis
#define DEVICE_WORN_TEMPERATURE_THRESHOLD 3050
#define DEVICE_NOT_WORN_TEMPERATURE_THRESHOLD 2950

enum device_state_t
{
	DEVICE_STATE_NOT_WORN_NOT_CHARGING,
	DEVICE_STATE_NOT_WORN_CHARGING,
	DEVICE_STATE_WORN,
	DEVICE_STATE_INIT,
};

static volatile bool charging = false;
static volatile bool worn = false;

static const struct device *gpio = DEVICE_DT_GET(GPIO_NODE);
static const struct device *temp_sensor = DEVICE_DT_GET(DT_NODELABEL(temp));
static const struct gpio_dt_spec chrsts_gpio = GPIO_DT_SPEC_GET_BY_IDX(DT_PATH(zephyr_user), chrsts_gpios, 0);

static struct gpio_callback chrsts_cb;

static struct k_work_delayable temperature_work;
static struct charging_work_t
{
	struct k_work work;
	bool charging_new_state;
} charging_work;

static enum device_state_t device_state = DEVICE_STATE_INIT;

static int update_state(bool charging_new_state, bool worn_new_state)
{
	int err;

	if (charging_new_state == charging && worn_new_state == worn)
	{
		// No change, do nothing
		return 0;
	}

	if (charging_new_state != charging)
	{
		// Charging state changed
		charging = charging_new_state;
		// Check if charging started or stopped
		if (charging)
		{
			// Enable the green LED
			err = ppg_set_led_pa(PPG_LED_GREEN, 32);
			if (err)
			{
				LOG_ERR("Failed to set PPG LED PA for LED %d", PPG_LED_GREEN);
				return err;
			}

			// Charging started
			device_state = DEVICE_STATE_NOT_WORN_CHARGING;
		}
		else
		{
			// Disable the green LED
			err = ppg_set_led_pa(PPG_LED_GREEN, 0);
			if (err)
			{
				LOG_ERR("Failed to disable PPG LED PA for LED %d", PPG_LED_GREEN);
				return err;
			}

			if (worn)
			{
				// Charging stopped while worn	
				device_state = DEVICE_STATE_WORN;
			}
			else
			{
				// Charging stopped while not worn
				device_state = DEVICE_STATE_NOT_WORN_NOT_CHARGING;
			}
		}
	}

	if (worn_new_state != worn)
	{
		// Worn state changed
		worn = worn_new_state;
		// Check if worn started or stopped
		if (worn)
		{
			// Enable the Red and IR LEDs
			err = ppg_set_led_pa(PPG_LED_RED, 32);
			if (err)
			{
				LOG_ERR("Failed to set PPG LED PA for LED %d", PPG_LED_RED);
				return err;
			}

			err = ppg_set_led_pa(PPG_LED_IR, 128);
			if (err)
			{
				LOG_ERR("Failed to set PPG LED PA for LED %d", PPG_LED_IR);
				return err;
			}

			// Worn started
			device_state = DEVICE_STATE_WORN;
		}
		else
		{
			// Disable the Red and IR LEDs
			err = ppg_set_led_pa(PPG_LED_RED, 0);
			if (err)
			{
				LOG_ERR("Failed to disable PPG LED PA for LED %d", PPG_LED_RED);
				return err;
			}

			err = ppg_set_led_pa(PPG_LED_IR, 0);
			if (err)
			{
				LOG_ERR("Failed to disable PPG LED PA for LED %d", PPG_LED_IR);
				return err;
			}
			
			if (charging)
			{
				// Worn stopped while charging
				device_state = DEVICE_STATE_NOT_WORN_CHARGING;
			}
			else
			{
				// Worn stopped while not charging
				device_state = DEVICE_STATE_NOT_WORN_NOT_CHARGING;
			}
		}
	}

	LOG_INF("Device state changed to %d", device_state);

	return 0;
}

static void charging_work_handler(struct k_work *work)
{
	struct charging_work_t *charging_work = CONTAINER_OF(work, struct charging_work_t, work);

	update_state(charging_work->charging_new_state, worn);
}

static void temperature_work_handler(struct k_work *work)
{
	int err;
	struct sensor_value temp_value;
	int16_t centitemp; // Temperature in centi-degrees Celsius

	err = sensor_sample_fetch(temp_sensor);
	if (err)
	{
		LOG_ERR("Failed to fetch temperature sample with error %d", err);
		k_work_reschedule(&temperature_work, K_SECONDS(CONFIG_TEMPERATURE_MEASUREMENT_INTERVAL));
		return;
	}

	err = sensor_channel_get(temp_sensor, SENSOR_CHAN_DIE_TEMP, &temp_value);
	if (err)
	{
		LOG_ERR("Failed to get temperature value with error %d", err);
		k_work_reschedule(&temperature_work, K_SECONDS(CONFIG_TEMPERATURE_MEASUREMENT_INTERVAL));
		return;
	}

	centitemp = temp_value.val1 * 100 + temp_value.val2 / 10000;
	LOG_INF("Temperature: %d.%02d C", centitemp / 100, centitemp % 100);

	// Check if the device is worn (temperature > 30C)
	if (centitemp > DEVICE_WORN_TEMPERATURE_THRESHOLD)
	{
		update_state(charging, true);
	}
	else if (centitemp < DEVICE_NOT_WORN_TEMPERATURE_THRESHOLD)
	{
		update_state(charging, false);
	}

	tgm_service_send_temp_notify(centitemp);

	k_work_reschedule(&temperature_work, K_SECONDS(CONFIG_TEMPERATURE_MEASUREMENT_INTERVAL));
}

int32_t battery_voltage_read(void)
{
	return battery_get_last_measurement();
}

static void chrsts_callback(const struct device *dev, struct gpio_callback *cb, uint32_t pins)
{
	int err;
	uint8_t pin_state;
	pin_state = gpio_pin_get_dt(&chrsts_gpio);

	if (pin_state == 0)
	{
		LOG_INF("Chrsts pin is not active, device is not charging");

		charging_work.charging_new_state = false;
		k_work_submit(&charging_work.work);

		// Toggle the interrupt to notify when the charging state changes to active
		err = gpio_pin_interrupt_configure(gpio, chrsts_gpio.pin, GPIO_INT_LEVEL_ACTIVE);
		if (err)
		{
			LOG_ERR("Failed to configure chrsts pin interrupt");
		}
	}
	else
	{
		LOG_INF("Chrsts pin is active, device is charging");

		charging_work.charging_new_state = true;
		k_work_submit(&charging_work.work);

		// Toggle the interrupt to notify when the charging state changes to inactive
		err = gpio_pin_interrupt_configure(gpio, chrsts_gpio.pin, GPIO_INT_LEVEL_INACTIVE);
		if (err)
		{
			LOG_ERR("Failed to configure chrsts pin interrupt");
		}
	}
}

struct tgm_service_cb tgm_service_callbacks = {
	.bat_cb = battery_voltage_read,
};

int main(void)
{
	int err;

	printk("TGM Application %s\n", APP_VERSION_STRING);

	// Initialize the gpio port
	if (!device_is_ready(gpio))
	{
		LOG_ERR("GPIO is not ready");
		return -1;
	}

	// Initialize the sens_enable pin as output
	err = gpio_pin_configure(gpio, SENS_ENABLE_PIN, GPIO_OUTPUT_HIGH);

	err = ble_init();
	if (err)
	{
		LOG_ERR("ble_init() returned %d", err);
		return err;
	}

	tgm_service_init(&tgm_service_callbacks);

	// Initialize the temperature monitoring
	k_work_init_delayable(&temperature_work, temperature_work_handler);

	ble_adv_start();

	err = battery_init(NULL);
	if (err)
	{
		LOG_ERR("battery_init() returned %d", err);
	}

	// Start the battery measurement before any of the sensors are started
	err = battery_start_measurement();
	if (err)
	{
		LOG_ERR("battery_start_measurement() returned %d", err);
	}

	// Enable the power for the sensors
	err = gpio_pin_set(gpio, SENS_ENABLE_PIN, 1);
	if (err)
	{
		LOG_ERR("Failed to enable sensor power");
		return err;
	}

	// Wait for the sensor to power up
	k_sleep(K_MSEC(100));

	err = ppg_init();
	if (err)
	{
		LOG_ERR("ppg_init() returned %d", err);
	}

	err = acc_init();
	if (err)
	{
		LOG_ERR("acc_init() returned %d", err);
	}

	// Initialize the chrsts pin as input
	err = gpio_pin_configure_dt(&chrsts_gpio, GPIO_INPUT);
	if (err)
	{
		LOG_ERR("Failed to configure chrsts pin");
		return err;
	}

	// Initialize the callback for the chrsts pin
	gpio_init_callback(&chrsts_cb, chrsts_callback, BIT(chrsts_gpio.pin));
	err = gpio_add_callback(gpio, &chrsts_cb);
	if (err)
	{
		LOG_ERR("Failed to add callback to chrsts pin");
		return err;
	}

	k_work_init(&charging_work.work, charging_work_handler);

	// Track the charging state
	err = gpio_pin_interrupt_configure(gpio, chrsts_gpio.pin, GPIO_INT_LEVEL_ACTIVE);
	if (err)
	{
		LOG_ERR("Failed to configure chrsts pin interrupt");
		return err;
	}

	// Start the sensors
	err = ppg_start();
	if (err)
	{
		LOG_ERR("Failed to start the PPG sensor with error %d", err);
	}

	err = acc_start();
	if (err)
	{
		LOG_ERR("Failed to start the accelerometer sensor with error %d", err);
	}

	// Start the temperature monitoring
	k_work_reschedule(&temperature_work, K_NO_WAIT);

	return 0;
}
```

## src/acc.c
```c
/*
 * Copyright (c) 2024 WeeGee bv
 */

#include <zephyr/devicetree.h>
#include <zephyr/drivers/gpio.h>
#include <zephyr/drivers/i2c.h>

#include "tgm_service.h"
#include "acc.h"

#include <zephyr/logging/log.h>
LOG_MODULE_REGISTER(acc, CONFIG_APP_LOG_LEVEL);

static struct gpio_callback acc_int_cb;
static struct k_work read_acc_data_work;

#if CONFIG_LIS2DTW12
#include <app/drivers/lis2dtw12.h>

#define LIS2DTW12_NODE DT_NODELABEL(lis2dtw12)
static struct gpio_dt_spec acc_int = GPIO_DT_SPEC_GET(LIS2DTW12_NODE, int_gpios);

static struct i2c_dt_spec i2c = I2C_DT_SPEC_GET(LIS2DTW12_NODE);
#else
// Give a build error
#error "No valid accelerometer sensor driver enabled"
#endif

/**
 * @brief Callback function for the accelerometer sensor interrupt
 *
 * @param dev Pointer to the gpio port that triggered the callback
 * @param cb Pointer to the callback data that was used to set up the callback
 * @param pins Bitmask of pins that triggered the callback
 * @return int
 */
static void acc_int_handler(const struct device *dev, struct gpio_callback *cb, uint32_t pins)
{
    if (pins & BIT(acc_int.pin))
    {
        // Read the accelerometer data outside of the ISR
        k_work_submit(&read_acc_data_work);
    }

    return;
}

static void acc_read_data(struct k_work *work)
{
    struct acc_sample acc_data[CONFIG_ACC_SAMPLES_PER_FRAME];
    uint8_t sample_count;

    // Get the accelerometer data
    int err = acc_sensor_get_data(&i2c, acc_data, &sample_count);
    if (err)
    {
        LOG_ERR("Failed to read accelerometer data");
        return;
    }

    // Notify the client of the accelerometer data
    err = tgm_service_send_acc_notify(acc_data, sample_count);
    if (err)
    {
        LOG_DBG("Failed to send accelerometer data notification");
        return;
    }

    return;
}

int acc_init(void)
{
    int err;

    // Initialize the I2C bus
    if (!i2c_is_ready_dt(&i2c))
    {
        LOG_ERR("I2C device not ready during initialization of accelerometer sensor");
        return -ENODEV;
    }

    // Initialize the GPIO port
    if (!gpio_is_ready_dt(&acc_int))
    {
        LOG_ERR("GPIO device not ready during initialization of accelerometer sensor");
        return -ENODEV;
    }

    // Intialize the int pin as input
    err = gpio_pin_configure_dt(&acc_int, GPIO_INPUT);
    if (err)
    {
        LOG_ERR("Failed to configure accelerometer sensor int pin as input");
        return err;
    }

    // Initialize the interrupt callback
    gpio_init_callback(&acc_int_cb, acc_int_handler, BIT(acc_int.pin));
    err = gpio_add_callback(acc_int.port, &acc_int_cb);
    if (err)
    {
        LOG_ERR("Failed to add callback to accelerometer sensor int pin");
        return err;
    }

    // Initialize the work item
    k_work_init(&read_acc_data_work, acc_read_data);

    return 0;
}

int acc_start(void)
{
    // Enable the interrupt
    int err = gpio_pin_interrupt_configure_dt(&acc_int, GPIO_INT_EDGE_TO_ACTIVE);
    if (err)
    {
        LOG_ERR("Failed to configure accelerometer sensor int pin interrupt");
        return err;
    }

    // Start the accelerometer sensor
    err = acc_sensor_start(&i2c);
    if (err)
    {
        LOG_ERR("Failed to start accelerometer sensor");
        return err;
    }

    return 0;
}

int acc_stop(void)
{
    // Stop the accelerometer sensor
    int err = acc_sensor_stop(&i2c);
    if (err)
    {
        LOG_ERR("Failed to stop accelerometer sensor");
        return err;
    }

    // Disable the interrupt
    err = gpio_pin_interrupt_configure_dt(&acc_int, GPIO_INT_DISABLE);
    if (err)
    {
        LOG_ERR("Failed to disable accelerometer sensor int pin interrupt");
        return err;
    }

    return 0;
}
```

## src/ble.c
```c
/*
 * Copyright (c) 2024 WeeGee bv
 */

#include <zephyr/bluetooth/addr.h>
#include <zephyr/bluetooth/conn.h>
#include <zephyr/bluetooth/gap.h>
#include <zephyr/bluetooth/gatt.h>

#include "ble.h"

#include <zephyr/logging/log.h>
LOG_MODULE_REGISTER(ble, CONFIG_APP_LOG_LEVEL);

static const struct bt_data ad[] = {
    BT_DATA_BYTES(BT_DATA_FLAGS, (BT_LE_AD_GENERAL | BT_LE_AD_NO_BREDR)), // No classic Bluetooth is supported, generally connectable
    BT_DATA(BT_DATA_NAME_COMPLETE, DEVICE_NAME, DEVICE_NAME_LEN)          // Include complete local name in advertising
};

static const struct bt_data sd[] = {}; // Can hold data for a scan response if applicable

static struct k_work adv_work;

void on_connected(struct bt_conn *conn, uint8_t err)
{
    if (err)
    {
        LOG_ERR("Connection error %d", err);
        return;
    }

    char addr[BT_ADDR_LE_STR_LEN];
    bt_addr_le_to_str(bt_conn_get_dst(conn), addr, sizeof(addr));
    LOG_INF("Connected to device with address %s", addr);

    struct bt_conn_info info;
    err = bt_conn_get_info(conn, &info);
    if (err)
    {
        LOG_ERR("bt_conn_get_info() returned %d", err);
        return;
    }

    double connection_interval = info.le.interval * 1.25; // in ms
    uint16_t supervision_timeout = info.le.timeout * 10;  // in ms
    LOG_INF("Connection parameters: interval %.2f ms, latency %d intervals, timeout %d ms", connection_interval, info.le.interval, supervision_timeout);
}

void on_disconnected(struct bt_conn *conn, uint8_t reason)
{
    LOG_INF("Disconnected, reason %d", reason);

    // Restart advertising
    k_work_submit(&adv_work);
}

void on_le_param_updated(struct bt_conn *conn, uint16_t interval, uint16_t latency, uint16_t timeout)
{
    double connection_interval = interval * 1.25; // in ms
    uint16_t supervision_timeout = timeout * 10;  // in ms
    LOG_INF("Connection parameters updated: interval %.2f ms, latency %d intervals, timeout %d ms", connection_interval, latency, supervision_timeout);
}

struct bt_conn_cb connection_callbacks = {
    .connected = on_connected,
    .disconnected = on_disconnected,
    .le_param_updated = on_le_param_updated,
};

static void advertising_process(struct k_work *work)
{
    int err;

    struct bt_le_adv_param adv_param = *BT_LE_ADV_PARAM(
    (
        BT_LE_ADV_OPT_CONNECTABLE |
        BT_LE_ADV_OPT_ONE_TIME |
        BT_LE_ADV_OPT_USE_IDENTITY),
    800, // Advertising interval set to about 500ms
    801,
    NULL);

    LOG_INF("Starting advertising with default parameters");
    err = bt_le_adv_start(&adv_param, ad, ARRAY_SIZE(ad), sd, ARRAY_SIZE(sd));

    if (err)
    {
        LOG_ERR("Advertising failed to start, err: %d\n", err);
        return;
    }
    LOG_INF("Advertising started\n");
}

/**
 * @brief Initialize the BLE functionality
 *
 * Register the callbacks and enable the BLE stack
 *
 * @return int Error code
 */
int ble_init(void)
{
    // Register connection callbacks
    bt_conn_cb_register(&connection_callbacks);

    // Initialize advertising work
    k_work_init(&adv_work, advertising_process);

    int err = bt_enable(NULL);
    if (err)
    {
        LOG_ERR("Bluetooth init failed (err %d)\n", err);
        return err;
    }
    LOG_INF("Bluetooth initialized\n");

    return 0;
}

/**
 * @brief Start advertising
 *
 * Start advertising with preset parameters
 *
 * @return int Error code
 */
int ble_adv_start(void)
{
    k_work_submit(&adv_work);
    return 0;
}
```

## src/ppg.c
```c
/*
 * Copyright (c) 2024 WeeGee bv
 */

#include <zephyr/devicetree.h>
#include <zephyr/drivers/gpio.h>
#include <zephyr/drivers/i2c.h>

#include "tgm_service.h"
#include "ppg.h"

#include <zephyr/logging/log.h>
LOG_MODULE_REGISTER(ppg, CONFIG_APP_LOG_LEVEL);

static struct gpio_callback ppg_int_cb;
static struct k_work read_ppg_data_work;

struct ppg_reg_work_t
{
    struct k_work reg_work;
    uint8_t reg;
    uint8_t data;
    bool read;
};

static void ppg_reg_work_handler(struct k_work *work);

static struct ppg_reg_work_t ppg_reg_work;

#if CONFIG_MAXM86161
#include <app/drivers/maxm86161.h>

#define MAXM86161_NODE DT_NODELABEL(maxm86161)
static struct gpio_dt_spec ppg_int = GPIO_DT_SPEC_GET(MAXM86161_NODE, int_gpios);

static struct i2c_dt_spec i2c = I2C_DT_SPEC_GET(MAXM86161_NODE);
#else
// Give a build error
#error "No valid PPG sensor driver enabled"
#endif

/**
 * @brief Callback function for the PPG sensor interrupt
 *
 * @param dev Pointer to the gpio port that triggered the callback
 * @param cb Pointer to the callback data that was used to set up the callback
 * @param pins Bitmask of pins that triggered the callback
 * @return int
 */
static void ppg_int_handler(const struct device *dev, struct gpio_callback *cb, uint32_t pins)
{
    if (pins & BIT(ppg_int.pin))
    {
        // Read the PPG data outside of the ISR
        k_work_submit(&read_ppg_data_work);
    }

    return;
}

static void ppg_read_data(struct k_work *work)
{
    struct ppg_sample ppg_data[CONFIG_PPG_SAMPLES_PER_FRAME];
    uint8_t sample_count;

    // Get the PPG data
    int err = ppg_sensor_get_data(&i2c, ppg_data, &sample_count);
    if (err)
    {
        LOG_ERR("Failed to read PPG data");
        return;
    }

    // Notify the client of the PPG data
    err = tgm_service_send_ppg_notify(ppg_data, sample_count);
    if (err)
    {
        LOG_DBG("Failed to send PPG data notification");
        return;
    }

    return;
}

int ppg_init(void)
{
    // Initialize the I2C bus
    if (!i2c_is_ready_dt(&i2c))
    {
        LOG_ERR("I2C device not ready during initialization of PPG sensor");
        return -ENODEV;
    }

    // Initialize the GPIO port
    if (!gpio_is_ready_dt(&ppg_int))
    {
        LOG_ERR("GPIO device not ready during initialization of PPG sensor");
        return -ENODEV;
    }

    // Intialize the int pin as input
    int err = gpio_pin_configure_dt(&ppg_int, GPIO_INPUT);
    if (err)
    {
        LOG_ERR("Failed to configure PPG sensor int pin as input");
        return err;
    }

    // Initialize the interrupt callback
    gpio_init_callback(&ppg_int_cb, ppg_int_handler, BIT(ppg_int.pin));
    err = gpio_add_callback(ppg_int.port, &ppg_int_cb);
    if (err)
    {
        LOG_ERR("Failed to add callback to PPG sensor int pin");
        return err;
    }

    // Initialize the work item
    k_work_init(&read_ppg_data_work, ppg_read_data);
    k_work_init(&ppg_reg_work.reg_work, ppg_reg_work_handler);

    return 0;
}

int ppg_start(void)
{
    // Enable the interrupt
    int err = gpio_pin_interrupt_configure_dt(&ppg_int, GPIO_INT_EDGE_TO_ACTIVE);
    if (err)
    {
        LOG_ERR("Failed to configure PPG sensor int pin interrupt");
        return err;
    }

    // Start the PPG sensor
    err = ppg_sensor_start(&i2c);
    if (err)
    {
        LOG_ERR("Failed to start PPG sensor");
        return err;
    }

    return 0;
}

int ppg_stop(void)
{
    // Stop the PPG sensor
    int err = ppg_sensor_stop(&i2c);
    if (err)
    {
        LOG_ERR("Failed to stop PPG sensor");
        return err;
    }

    // Disable the interrupt
    err = gpio_pin_interrupt_configure_dt(&ppg_int, GPIO_INT_DISABLE);
    if (err)
    {
        LOG_ERR("Failed to disable PPG sensor int pin interrupt");
        return err;
    }

    return 0;
}

int ppg_read_reg(uint8_t reg)
{
    uint8_t data;
    int err = ppg_sensor_read_reg(&i2c, reg, &data);
    if (err)
    {
        LOG_ERR("Failed to read PPG sensor register 0x%02X", reg);
        return err;
    }

    return 0;
}

int ppg_write_reg(uint8_t reg, uint8_t data)
{
    int err = ppg_sensor_write_reg(&i2c, reg, data);
    if (err)
    {
        LOG_ERR("Failed to write PPG sensor register 0x%02X", reg);
        return err;
    }

    return 0;
}

static void ppg_reg_work_handler(struct k_work *work)
{
    int err;
    struct ppg_reg_work_t *ppg_reg_work = CONTAINER_OF(work, struct ppg_reg_work_t, reg_work);

    uint8_t final_reg_data;
    if (ppg_reg_work->read)
    {
        err = ppg_sensor_read_reg(&i2c, ppg_reg_work->reg, &final_reg_data);
        if (err)
        {
            LOG_ERR("Failed to read PPG sensor register 0x%02X", ppg_reg_work->reg);
            return;
        }

        err = tgm_service_send_read_ppg_reg_notify(final_reg_data);
    }
    else
    {
        err = ppg_sensor_write_reg(&i2c, ppg_reg_work->reg, ppg_reg_work->data);
        if (err)
        {
            LOG_ERR("Failed to write PPG sensor register 0x%02X", ppg_reg_work->reg);
            return;
        }
        err = ppg_sensor_read_reg(&i2c, ppg_reg_work->reg, &final_reg_data);
        if (err)
        {
            LOG_ERR("Failed to read PPG sensor register 0x%02X after writing", ppg_reg_work->reg);
            // Allow to continue since the write was successful
        }

        err = tgm_service_send_write_ppg_reg_notify(final_reg_data);
    }

    if (err)
    {
        LOG_ERR("Failed to send PPG register value notification");
        return;
    }

    return;
}
```

## src/ppg.h
```c
/*
 * Copyright (c) 2024 WeeGee bv
 */

#ifndef PPG_H_
#define PPG_H_

#include <zephyr/kernel.h>

/**
 * @brief Initialize the PPG sensor
 *
 * @return int 0 on success, negative error code on failure
 */
int ppg_init(void);

/**
 * @brief Start the PPG sensor with default configuration
 *
 * @return int 0 on success, negative error code on failure
 */
int ppg_start(void);

/**
 * @brief Stop the PPG sensor
 *
 * @return int 0 on success, negative error code on failure
 */
int ppg_stop(void);

/**
 * @brief Read a register from the PPG sensor and report over BLE
 *
 * @param[in] reg Register address
 * @return int 0 on success, negative error code on failure
 */
int ppg_read_reg(uint8_t reg);

/**
 * @brief Write a register to the PPG sensor and report over BLE
 *
 * @param[in] reg Register address
 * @param[in] data Data to write
 * @return int 0 on success, negative error code on failure
 */
int ppg_write_reg(uint8_t reg, uint8_t data);

#endif /* PPG_H_ */
```

## src/tgm_service.c
```c
/*
 * Copyright (c) 2024 WeeGee bv
 */

#include <zephyr/bluetooth/bluetooth.h>
#include <zephyr/bluetooth/conn.h>
#include <zephyr/bluetooth/gatt.h>
#include <zephyr/bluetooth/hci.h>
#include <zephyr/bluetooth/uuid.h>

#include <app_version.h>
#include "tgm_service.h"
#include "ppg.h"

#include <zephyr/logging/log.h>
LOG_MODULE_REGISTER(tgm_service, CONFIG_APP_LOG_LEVEL);

static bool notify_ppg_data;
static bool notify_acc_data;
static bool notify_temp_data;
static bool notify_battery;
static bool notify_read_ppg_reg;
static bool notify_write_ppg_reg;

static uint32_t ppg_frame_counter = 0;
static uint32_t acc_frame_counter = 0;

static struct tgm_service_ppg_data_t tgm_service_ppg_data;
static struct tgm_service_acc_data_t tgm_service_acc_data;
static struct tgm_service_temp_data_t tgm_service_temp_data;
static uint16_t bat_value;
static uint64_t uuid_value;
static char fw_version[15] = APP_VERSION_STRING;
static struct tgm_service_cb *tgm_service_cb = NULL;

static void tgm_service_ccc_ppg_data_cfg_changed(const struct bt_gatt_attr *attr, uint16_t value)
{
    LOG_INF("Enabled notifications for ppg data");
    notify_ppg_data = (value == BT_GATT_CCC_NOTIFY);
}

static void tgm_service_ccc_acc_data_cfg_changed(const struct bt_gatt_attr *attr, uint16_t value)
{
    LOG_INF("Enabled notifications for acc data");
    notify_acc_data = (value == BT_GATT_CCC_NOTIFY);
}

static void tgm_service_ccc_temp_data_cfg_changed(const struct bt_gatt_attr *attr, uint16_t value)
{
    LOG_INF("Enabled notifications for temp data");
    notify_temp_data = (value == BT_GATT_CCC_NOTIFY);
}

static void tgm_service_ccc_bat_cfg_changed(const struct bt_gatt_attr *attr, uint16_t value)
{
    LOG_INF("Enabled notifications for battery data");
    notify_battery = (value == BT_GATT_CCC_NOTIFY);
}

static void tgm_service_ccc_read_ppg_reg_data_cfg_changed(const struct bt_gatt_attr *attr, uint16_t value)
{
    LOG_INF("Enabled notifications for read ppg reg data");
    notify_read_ppg_reg = (value == BT_GATT_CCC_NOTIFY);
}

static void tgm_service_ccc_write_ppg_reg_data_cfg_changed(const struct bt_gatt_attr *attr, uint16_t value)
{
    LOG_INF("Enabled notifications for write ppg reg data");
    notify_write_ppg_reg = (value == BT_GATT_CCC_NOTIFY);
}

// Callback function to get the battery value when the client reads this value
static ssize_t get_bat_value(struct bt_conn *conn, const struct bt_gatt_attr *attr, void *buf, uint16_t len, uint16_t offset)
{
    // Get a pointer to bat_value
    const int32_t *value = attr->user_data;

    LOG_INF("Reading battery value");

    if (tgm_service_cb && tgm_service_cb->bat_cb)
    {
        bat_value = tgm_service_cb->bat_cb();
        return bt_gatt_attr_read(conn, attr, buf, len, offset, value, sizeof(bat_value));
    }

    return 0;
}

// Callback function to get the UUID value when the client reads this value
static ssize_t get_uuid_value(struct bt_conn *conn, const struct bt_gatt_attr *attr, void *buf, uint16_t len, uint16_t offset)
{
    // Get a pointer to uuid_value
    const uint64_t *value = attr->user_data;

    LOG_INF("Reading UUID value");

    uuid_value = ((uint64_t)NRF_FICR->DEVICEID[1] << 32) | NRF_FICR->DEVICEID[0];
    return bt_gatt_attr_read(conn, attr, buf, len, offset, value, sizeof(*value));
}

// Callback function to get the firmware version when the client reads this value
static ssize_t get_fw_version(struct bt_conn *conn, const struct bt_gatt_attr *attr, void *buf, uint16_t len, uint16_t offset)
{
    // Get a pointer to fw_version string
    const char *value = attr->user_data;

    LOG_INF("Reading firmware version");
    return bt_gatt_attr_read(conn, attr, buf, len, offset, value, strlen(value));
}

// Callback function to read the PPG register when the client writes to this value
static ssize_t read_ppg_reg(struct bt_conn *conn, const struct bt_gatt_attr *attr, const void *buf, uint16_t len, uint16_t offset, uint8_t flags)
{
    if (len != 1u)
    {
        LOG_DBG("Invalid length for PPG register read");
        return BT_GATT_ERR(BT_ATT_ERR_INVALID_ATTRIBUTE_LEN);
    }

    if (offset != 0)
    {
        LOG_DBG("Invalid offset for PPG register read");
        return BT_GATT_ERR(BT_ATT_ERR_INVALID_OFFSET);
    }

    uint8_t ppg_reg = *((uint8_t *)buf);

    LOG_INF("Reading PPG register");
    ppg_read_reg(ppg_reg);

    return len;
}

// Callback function to write the PPG register when the client writes to this value
static ssize_t write_ppg_reg(struct bt_conn *conn, const struct bt_gatt_attr *attr, const void *buf, uint16_t len, uint16_t offset, uint8_t flags)
{
    if (len != 2u)
    {
        LOG_DBG("Invalid length for PPG register write");
        return BT_GATT_ERR(BT_ATT_ERR_INVALID_ATTRIBUTE_LEN);
    }

    if (offset != 0)
    {
        LOG_DBG("Invalid offset for PPG register write");
        return BT_GATT_ERR(BT_ATT_ERR_INVALID_OFFSET);
    }

    uint8_t ppg_reg = *((uint8_t *)buf);
    uint8_t ppg_reg_data = *((uint8_t *)buf + 1);

    LOG_INF("Writing PPG register");
    ppg_write_reg(ppg_reg, ppg_reg_data);

    return len;
}

BT_GATT_SERVICE_DEFINE(
    tgm_service_svc,
    BT_GATT_PRIMARY_SERVICE(BT_UUID_TGM),
    BT_GATT_CHARACTERISTIC(
        BT_UUID_TGM_UUID,
        BT_GATT_CHRC_READ,
        BT_GATT_PERM_READ,
        get_uuid_value, NULL,
        &uuid_value),
    BT_GATT_CHARACTERISTIC(
        BT_UUID_TGM_FW,
        BT_GATT_CHRC_READ,
        BT_GATT_PERM_READ,
        get_fw_version, NULL,
        &fw_version),
    BT_GATT_CHARACTERISTIC(
        BT_UUID_TGM_BAT,
        BT_GATT_CHRC_READ | BT_GATT_CHRC_NOTIFY,
        BT_GATT_PERM_READ,
        get_bat_value, NULL,
        &bat_value),
    BT_GATT_CCC(tgm_service_ccc_bat_cfg_changed, BT_GATT_PERM_READ | BT_GATT_PERM_WRITE),
    BT_GATT_CHARACTERISTIC(
        BT_UUID_TGM_PPG,
        BT_GATT_CHRC_NOTIFY,
        BT_GATT_PERM_READ,
        NULL, NULL,
        &tgm_service_ppg_data),
    BT_GATT_CCC(tgm_service_ccc_ppg_data_cfg_changed, BT_GATT_PERM_READ | BT_GATT_PERM_WRITE),
    BT_GATT_CHARACTERISTIC(
        BT_UUID_TGM_ACC,
        BT_GATT_CHRC_NOTIFY,
        BT_GATT_PERM_READ,
        NULL, NULL,
        &tgm_service_acc_data),
    BT_GATT_CCC(tgm_service_ccc_acc_data_cfg_changed, BT_GATT_PERM_READ | BT_GATT_PERM_WRITE),
    BT_GATT_CHARACTERISTIC(
        BT_UUID_TGM_TEMP,
        BT_GATT_CHRC_NOTIFY,
        BT_GATT_PERM_READ,
        NULL, NULL,
        &tgm_service_temp_data),
    BT_GATT_CCC(tgm_service_ccc_temp_data_cfg_changed, BT_GATT_PERM_READ | BT_GATT_PERM_WRITE),
    BT_GATT_CHARACTERISTIC(
        BT_UUID_TGM_READ_PPG_REG,
        BT_GATT_CHRC_WRITE | BT_GATT_CHRC_NOTIFY,
        BT_GATT_PERM_WRITE,
        NULL, read_ppg_reg,
        NULL),
    BT_GATT_CCC(tgm_service_ccc_read_ppg_reg_data_cfg_changed, BT_GATT_PERM_READ | BT_GATT_PERM_WRITE),
    BT_GATT_CHARACTERISTIC(
        BT_UUID_TGM_WRITE_PPG_REG,
        BT_GATT_CHRC_WRITE | BT_GATT_CHRC_NOTIFY,
        BT_GATT_PERM_WRITE,
        NULL, write_ppg_reg,
        NULL),
    BT_GATT_CCC(tgm_service_ccc_write_ppg_reg_data_cfg_changed, BT_GATT_PERM_READ | BT_GATT_PERM_WRITE), );

int tgm_service_init(struct tgm_service_cb *callbacks)
{
    if (callbacks)
    {
        tgm_service_cb = callbacks;
    }

    return 0;
}

int tgm_service_send_battery_notify(int32_t battery_value)
{
    if (!notify_battery)
    {
        return -EACCES;
    }

    return bt_gatt_notify(NULL, &tgm_service_svc.attrs[6], &battery_value, sizeof(battery_value));
}

int tgm_service_send_ppg_notify(struct ppg_sample *ppg_data, uint8_t sample_cnt)
{
    struct tgm_service_ppg_data_t ppg_data_notify = {
        .frame_counter = ppg_frame_counter++};
    memcpy(&ppg_data_notify.ppg_data, ppg_data, sizeof(struct ppg_sample) * sample_cnt);
    if (!notify_ppg_data)
    {
        return -EACCES;
    }

    return bt_gatt_notify(NULL, &tgm_service_svc.attrs[9], &ppg_data_notify, sizeof(struct tgm_service_ppg_data_t));
}

int tgm_service_send_acc_notify(struct acc_sample *acc_data, uint8_t sample_cnt)
{
    struct tgm_service_acc_data_t acc_data_notify = {
        .frame_counter = acc_frame_counter++};
    memcpy(&acc_data_notify.acc_data, acc_data, sizeof(struct acc_sample) * sample_cnt);
    if (!notify_acc_data)
    {
        return -EACCES;
    }

    return bt_gatt_notify(NULL, &tgm_service_svc.attrs[12], &acc_data_notify, sizeof(struct tgm_service_acc_data_t));
}

int tgm_service_send_temp_notify(struct tgm_service_temp_data_t *new_temp_data)
{
    if (!notify_temp_data)
    {
        return -EACCES;
    }

    return bt_gatt_notify(NULL, &tgm_service_svc.attrs[15], new_temp_data, sizeof(*new_temp_data));
}

int tgm_service_send_read_ppg_reg_notify(uint8_t ppg_reg_data)
{
    if (!notify_read_ppg_reg)
    {
        return -EACCES;
    }

    return bt_gatt_notify(NULL, &tgm_service_svc.attrs[18], &ppg_reg_data, sizeof(ppg_reg_data));
}

int tgm_service_send_write_ppg_reg_notify(uint8_t ppg_reg_data)
{
    if (!notify_write_ppg_reg)
    {
        return -EACCES;
    }

    return bt_gatt_notify(NULL, &tgm_service_svc.attrs[21], &ppg_reg_data, sizeof(ppg_reg_data));
}
```

## src/tgm_service.h
```c
/*
 * Copyright (c) 2024 WeeGee bv
 */

#ifndef TGM_SERVICE_H_
#define TGM_SERVICE_H_

#include <app/drivers/maxm86161.h> // For ppg_sample, but fix this later
#include <app/drivers/lis2dtw12.h> // For acc_sample, but fix this later

/**@file
 * @defgroup tgm_service TGM Service implementation
 * @{
 * @brief API for the TGM Bluetooth service.
 */

/**
 * @brief TGM Service 128 bit UUID for the GATT service and its characteristics
 *
 * Generated using guidgenerator.com
 */
#define BT_UUID_TGM_VAL \
    BT_UUID_128_ENCODE(0x3a0ff000, 0x98c4, 0x46b2, 0x94af, 0x1aee0fd4c48e)

#define BT_UUID_TGM_PPG_VAL \
    BT_UUID_128_ENCODE(0x3a0ff001, 0x98c4, 0x46b2, 0x94af, 0x1aee0fd4c48e)

#define BT_UUID_TGM_ACC_VAL \
    BT_UUID_128_ENCODE(0x3a0ff002, 0x98c4, 0x46b2, 0x94af, 0x1aee0fd4c48e)

#define BT_UUID_TGM_TEMP_VAL \
    BT_UUID_128_ENCODE(0x3a0ff003, 0x98c4, 0x46b2, 0x94af, 0x1aee0fd4c48e)

#define BT_UUID_TGM_BAT_VAL \
    BT_UUID_128_ENCODE(0x3a0ff004, 0x98c4, 0x46b2, 0x94af, 0x1aee0fd4c48e)

#define BT_UUID_TGM_UUID_VAL \
    BT_UUID_128_ENCODE(0x3a0ff005, 0x98c4, 0x46b2, 0x94af, 0x1aee0fd4c48e)

#define BT_UUID_TGM_FW_VAL \
    BT_UUID_128_ENCODE(0x3a0ff006, 0x98c4, 0x46b2, 0x94af, 0x1aee0fd4c48e)

#define BT_UUID_TGM_READ_PPG_REG_VAL \
    BT_UUID_128_ENCODE(0x3a0ff007, 0x98c4, 0x46b2, 0x94af, 0x1aee0fd4c48e)

#define BT_UUID_TGM_WRITE_PPG_REG_VAL \
    BT_UUID_128_ENCODE(0x3a0ff008, 0x98c4, 0x46b2, 0x94af, 0x1aee0fd4c48e)

#define BT_UUID_TGM BT_UUID_DECLARE_128(BT_UUID_TGM_VAL)
#define BT_UUID_TGM_PPG BT_UUID_DECLARE_128(BT_UUID_TGM_PPG_VAL)
#define BT_UUID_TGM_ACC BT_UUID_DECLARE_128(BT_UUID_TGM_ACC_VAL)
#define BT_UUID_TGM_TEMP BT_UUID_DECLARE_128(BT_UUID_TGM_TEMP_VAL)
#define BT_UUID_TGM_BAT BT_UUID_DECLARE_128(BT_UUID_TGM_BAT_VAL)
#define BT_UUID_TGM_UUID BT_UUID_DECLARE_128(BT_UUID_TGM_UUID_VAL)
#define BT_UUID_TGM_FW BT_UUID_DECLARE_128(BT_UUID_TGM_FW_VAL)
#define BT_UUID_TGM_READ_PPG_REG BT_UUID_DECLARE_128(BT_UUID_TGM_READ_PPG_REG_VAL)
#define BT_UUID_TGM_WRITE_PPG_REG BT_UUID_DECLARE_128(BT_UUID_TGM_WRITE_PPG_REG_VAL)

#define CONFIG_TEMP_SAMPLES_PER_FRAME 10

/** @brief PPG Data Struct used by the TGM service to inform the client of new PPG data. */
struct tgm_service_ppg_data_t
{
    /** Frame counter*/
    uint32_t frame_counter;
    /** PPG data. */
    struct ppg_sample ppg_data[CONFIG_PPG_SAMPLES_PER_FRAME];
};

/** @brief Accelerometer Data Struct used by the TGM service to inform the client of new accelerometer data. */
struct tgm_service_acc_data_t
{
    /** Frame counter*/
    uint32_t frame_counter;
    /** ACC data. */
    struct acc_sample acc_data[CONFIG_ACC_SAMPLES_PER_FRAME];
};

struct temp_sample
{
    int16_t temp;
};
/** @brief Temperature Data Struct used by the TGM service to inform the client of new temperature data. */
struct tgm_service_temp_data_t
{
    /** Frame counter*/
    uint32_t frame_counter;
    /** Temperature data. */
    struct temp_sample temp_data[CONFIG_TEMP_SAMPLES_PER_FRAME];
};

/** @brief Callback type for when PPG data is pulled. */
typedef void (*tgm_service_ppg_cb_t)(struct tgm_service_ppg_data_t *ppg_data);

/** @brief Callback type for when accelerometer data is pulled. */
typedef void (*tgm_service_acc_cb_t)(struct tgm_service_acc_data_t *acc_data);

/** @brief Callback type for when temperature data is pulled. */
typedef void (*tgm_service_temp_cb_t)(struct tgm_service_temp_data_t *temp_data);

/** @brief Callback type for when the battery value is pulled. */
typedef int32_t (*tgm_service_bat_cb_t)(void);

/** @brief Callback struct used by the TGM Service. */
struct tgm_service_cb
{
    /** PPG data callback. */
    tgm_service_ppg_cb_t ppg_cb;
    /** Accelerometer data callback. */
    tgm_service_acc_cb_t acc_cb;
    /** Temperature data callback. */
    tgm_service_temp_cb_t temp_cb;
    /** Battery value callback. */
    tgm_service_bat_cb_t bat_cb;
};

/** @brief Initialize the TGM Service.
 *
 * This function registers application callback functions with the TGM Service
 *
 * @param[in] callbacks Struct containing pointers to callback functions
 *			used by the service. This pointer can be NULL
 *			if no callback functions are defined.
 *
 *
 * @retval 0 If the operation was successful.
 *           Otherwise, a (negative) error code is returned.
 */
int tgm_service_init(struct tgm_service_cb *callbacks);

/** @brief Notify the client of a PPG data change.
 *
 * This function notifies the connected client device of an update to the PPG
 * data
 *
 * @param[in] ppg_data ppg_sample struct containing the PPG sensor data
 * @param[in] sample_cnt Number of samples to be sent
 * @retval 0 If the operation was successful.
 *           Otherwise, a (negative) error code is returned.
 */
int tgm_service_send_ppg_notify(struct ppg_sample *ppg_data, uint8_t sample_cnt);

/** @brief Notify the client of an accelerometer data change.
 *
 * This function notifies the connected client device of an update to the accelerometer
 * data
 *
 * @param[in] acc_data acc_sample struct containing the accelerometer sensor data
 * @param[in] sample_cnt Number of samples to be sent
 * @retval 0 If the operation was successful.
 *           Otherwise, a (negative) error code is returned.
 */
int tgm_service_send_acc_notify(struct acc_sample *acc_data, uint8_t sample_cnt);

/** @brief Notify the client of a temperature data change.
 *
 * This function notifies the connected client device of an update to the temperature
 * data
 *
 * @param[in] temp_data tgm_service_temp_data_t struct containing a frame counter and temperature sensor data
 *
 *
 * @retval 0 If the operation was successful.
 *           Otherwise, a (negative) error code is returned.
 */
int tgm_service_send_temp_notify(struct tgm_service_temp_data_t *temp_data);

/** @brief Notify the client of a battery value change.
 *
 * This function notifies the connected client device of an update to the battery
 * value
 *
 * @param[in] battery_value Battery value in mV (uint16)
 *
 *
 * @retval 0 If the operation was successful.
 *           Otherwise, a (negative) error code is returned.
 */
int tgm_service_send_battery_notify(int32_t battery_value);

/**
 * @brief Notify the client of a PPG register read.
 *
 * This function notifies the connected client device of a read PPG register
 *
 * @param[in] ppg_reg_data PPG register data
 * @retval 0 If the operation was successful.
 */
int tgm_service_send_read_ppg_reg_notify(uint8_t ppg_reg_data);

/**
 * @brief Notify the client of a PPG register write.
 *
 * This function notifies the connected client device of a write PPG register
 *
 * @param[in] ppg_reg_data PPG register data
 * @retval 0 If the operation was successful.
 */
int tgm_service_send_write_ppg_reg_notify(uint8_t ppg_reg_data);

/**
 * @}
 */

#endif /* TGM_SERVICE_H_ */
```
